## conf/layer.conf
```bitbake
# We have a conf and classes directory, add to BBPATH
BBPATH .= ":${LAYERDIR}"

# We have a recipes-* directories, add to BBFILES
BBFILES += "${LAYERDIR}/recipes-*/*/*.bb \
	${LAYERDIR}/recipes-*/*/*.bbappend"

BBFILE_COLLECTIONS += "vexpress_superfifo_vp"
BBFILE_PATTERN_vexpress_superfifo_vp = "^${LAYERDIR}/"
#BBFILE_PRIORITY_vexpress_superfifo_vp = "6"
BBFILE_PRIORITY_vexpress_superfifo_vp = "10"
BB_DANGLINGAPPENDS_WARNONLY="1"
```

## conf/machine/vexpress_superfifo_vp.conf
```bitbake
#@TYPE: Machine
#@NAME: vexpress_superfifo_vp

#@DESCRIPTION: Machine configuration for vexpress_superfifo_vp systems

PREFERRED_PROVIDER_virtual/xserver = "xserver-xorg"
XSERVER = "xserver-xorg \
           xf86-input-evdev \
           xf86-input-mouse \
           xf86-video-omap \
           xf86-input-keyboard"

# Ship all kernel modules by default
MACHINE_EXTRA_RRECOMMENDS = " kernel-modules"

MACHINE_FEATURES = "lttng2"

EXTRA_IMAGEDEPENDS += "u-boot"
CORE_IMAGE_EXTRA_INSTALL += "libstdc++"
IMAGE_INSTALL_append = " libstdc++"
IMAGE_INSTALL_append = " kernel-module-super-fifo-drv"


# Uncomment the following line to enable the hard floating point abi. Note that
# this breaks some binary libraries and 3D (neither of which ship with
# meta-yocto). For maximum compatibility, leave this disabled.
#DEFAULTTUNE ?= "cortexa8hf-neon"
include conf/machine/include/tune-cortexa9.inc

IMAGE_FSTYPES += "ext2"

SERIAL_CONSOLE = "115200 ttyAMA0"

PREFERRED_PROVIDER_virtual/kernel ?= "linux"
PREFERRED_VERSION_linux ?= "3.6.8%"

KERNEL_IMAGETYPE = "zImage"
KERNEL_ALT_IMAGETYPE = "dtbs"

KERNEL_DEVICETREE = "vexpress-v2p-ca9.dtb"

UBOOT_BINARY = "u-boot.bin"
#UBOOT_SUFFIX = "elf"
UBOOT_MACHINE = "ca9x4_ct_vxp_config"
UBOOT_ENTRYPOINT = "0x80008000"
UBOOT_LOADADDRESS = "0x80008000"
UBOOT_SRCPV = "1"
```
